## examples/esp32-s3-usb-bridge/examples/usb_wireless_bridge/sdkconfig.defaults.esp32s3
```kconfig
CONFIG_IDF_TARGET="esp32s3"
CONFIG_ESP32S3_INSTRUCTION_CACHE_16KB=y
CONFIG_ESP32S3_DATA_CACHE_32KB=y
CONFIG_ESP_DEFAULT_CPU_FREQ_MHZ_240=y
```
